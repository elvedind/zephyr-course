## app/boards/scratchboard/board.yml
```yaml
board:
  name: scratchboard
  full_name: From scratch board definition
  vendor: elvedin
  socs:
    - name: nrf54l05
    - name: nrf54l10
      variants:
        - name: ns
          cpucluster: cpuapp
    - name: nrf54l15
      variants:
        - name: xip
          cpucluster: cpuflpr
        - name: ns
          cpucluster: cpuapp
runners:
  run_once:
    '--recover':
      - runners:
          - nrfjprog
          - nrfutil
        run: first
        groups:
          - boards:
              - nrf54l15/nrf54l15/cpuapp
              - nrf54l15/nrf54l15/cpuapp/ns
              - nrf54l15/nrf54l15/cpuflpr
              - nrf54l15/nrf54l15/cpuflpr/xip
    '--erase':
      - runners:
          - nrfjprog
          - jlink
          - nrfutil
        run: first
        groups:
          - boards:
              - nrf54l15/nrf54l15/cpuapp
              - nrf54l15/nrf54l15/cpuapp/ns
              - nrf54l15/nrf54l15/cpuflpr
              - nrf54l15/nrf54l15/cpuflpr/xip
    '--reset':
      - runners:
          - nrfjprog
          - jlink
          - nrfutil
        run: last
        groups:
          - boards:
              - nrf54l15/nrf54l15/cpuapp
              - nrf54l15/nrf54l15/cpuapp/ns
              - nrf54l15/nrf54l15/cpuflpr
              - nrf54l15/nrf54l15/cpuflpr/xip
```

## twister-out.1/native_sim_native/host/homework.unit.ring_buf/Kconfig/boards/Kconfig.defconfig
```kconfig
# Load Zephyr board defconfig descriptions.
osource "/home/elvedin/Documents/iomico_zfc/mo2/deps/zephyr/boards/native/native_sim/Kconfig.defconfig"
```

## twister-out/native_sim_native/host/homework.unit.ring_buf/Kconfig/Kconfig.modules
```kconfig
menu "cmsis_6 (/home/elvedin/Documents/iomico_zfc/mo2/deps/modules/hal/cmsis_6)"
osource "$(ZEPHYR_CMSIS_6_KCONFIG)"
config ZEPHYR_CMSIS_6_MODULE
	bool
	default y
endmenu
menu "hal_nordic (/home/elvedin/Documents/iomico_zfc/mo2/deps/modules/hal/nordic)"
osource "$(ZEPHYR_HAL_NORDIC_KCONFIG)"
config ZEPHYR_HAL_NORDIC_MODULE
	bool
	default y

config ZEPHYR_HAL_NORDIC_MODULE_BLOBS
	bool
endmenu
```

## twister-out/native_sim_native/host/homework.unit.ring_buf/Kconfig/arch/Kconfig
```kconfig
# Load Zephyr Arch Kconfig descriptions.
osource "/home/elvedin/Documents/iomico_zfc/mo2/deps/zephyr/arch/rx/Kconfig"
osource "/home/elvedin/Documents/iomico_zfc/mo2/deps/zephyr/arch/x86/Kconfig"
osource "/home/elvedin/Documents/iomico_zfc/mo2/deps/zephyr/arch/xtensa/Kconfig"
osource "/home/elvedin/Documents/iomico_zfc/mo2/deps/zephyr/arch/sparc/Kconfig"
osource "/home/elvedin/Documents/iomico_zfc/mo2/deps/zephyr/arch/riscv/Kconfig"
osource "/home/elvedin/Documents/iomico_zfc/mo2/deps/zephyr/arch/posix/Kconfig"
osource "/home/elvedin/Documents/iomico_zfc/mo2/deps/zephyr/arch/mips/Kconfig"
osource "/home/elvedin/Documents/iomico_zfc/mo2/deps/zephyr/arch/arm64/Kconfig"
osource "/home/elvedin/Documents/iomico_zfc/mo2/deps/zephyr/arch/arm/Kconfig"
osource "/home/elvedin/Documents/iomico_zfc/mo2/deps/zephyr/arch/arc/Kconfig"
```

## twister-out/native_sim_native/host/homework.unit.ring_buf/Kconfig/boards/Kconfig
```kconfig
# Load Zephyr board Kconfig descriptions.
osource "/home/elvedin/Documents/iomico_zfc/mo2/deps/zephyr/boards/native/native_sim/Kconfig"
```

## twister-out/native_sim_native/host/homework.unit.ring_buf/Kconfig/boards/Kconfig.native_sim
```kconfig
# Load board Kconfig descriptions.
osource "/home/elvedin/Documents/iomico_zfc/mo2/deps/zephyr/boards/native/native_sim/Kconfig.native_sim"
```

## twister-out/native_sim_native/host/homework.unit.ring_buf/Kconfig/boards/Kconfig.sysbuild
```kconfig
# Load Sysbuild board Kconfig descriptions.
osource "/home/elvedin/Documents/iomico_zfc/mo2/deps/zephyr/boards/native/native_sim/Kconfig.sysbuild"
```
